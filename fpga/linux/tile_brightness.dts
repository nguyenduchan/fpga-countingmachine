/dts-v1/;
/plugin/;

/ {
    fragment@0 {
        target = <&fpga_full>;
        __overlay__ {
            firmware-name = "tile_brightness.bit.bin";
            resets = <&zynqmp_reset 116>;
        };
    };

    fragment@1 {
        target = <&amba>;
        __overlay__ {
            #address-cells = <2>;
            #size-cells = <2>;
            tile_brightness: tile_brightness@a0000000 {
                compatible = "generic-uio";
                reg = <0x0 0xa0000000 0x0 0x10000>;
                clocks = <&zynqmp_clk 71>;
            };
        };
    };
};
